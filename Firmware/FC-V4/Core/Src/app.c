/* ============================================================================
 * app.c  —  Boot sequence, rate-group cyclic executive and fault arbiter
 *
 * Boot   BOOT: drivers, USB, log scan, GPS wiring check, IMU init + self-test
 *        CALIBRATE: gyro bias (still, any orientation), attitude seed from accel,
 *                   control-path check -> SETTLING, watchdog started
 * Frame  100 Hz, TIM5-paced, fixed cadence (never re-synced, std B2), with a
 *        static task table (h743_flight_architecture §1.3). Mandatory tasks
 *        check in; the IWDG is kicked only if all of them ran this frame.
 * Arbiter (FDS-01 P3): the FDIR engine reports, flight.c decides — phase
 *        transitions (READY gating, demotion, LOCKOUT/CATO_SAFE) and the
 *        control-mode ceiling (FULL -> RATE_DAMP -> OFF).
 * All mutable state lives in the single file-scope struct A, owned here.
 * ============================================================================ */
#include "app.h"
#include "board.h"
#if __has_include("build_id.h")
#include "build_id.h"          /* generated by makefile.init */
#else
#define BUILD_GIT_SHA "nogit"
#endif
#include "console.h"
#include "control.h"
#include "detect.h"
#include "fdir.h"
#include "flashlog.h"
#include "fwupdate.h"
#include "gps.h"
#if CFG_HITL
#include "hitl.h"
#endif
#include "iekf.h"
#include "imu.h"
#include "leds.h"
#include "logrec.h"
#include "logq.h"
#include "flight.h"
#include "nav.h"
#include "phase.h"
#include "pwm.h"
#include "sched.h"
#include "telemetry.h"
#include "usbio.h"
#include "wdg.h"
#include <math.h>
#include <stdio.h>
#include <stdlib.h>
#include <string.h>

/* Build ID at a fixed place right after the vector table (linker .build_id),
 * readable from the .bin/.elf, the debugger and every log session (std E3). */
__attribute__((used, section(".build_id")))
const char g_build_id[32] = BUILD_GIT_SHA " " __DATE__;

#define D2R 0.017453292519943295f
#define R2D 57.29577951308232f

/* Task check-in bits; the watchdog is kicked only when all are set. */
#define CK_SENSE  (1u << 0)
#define CK_EST    (1u << 1)
#define CK_FDIR   (1u << 2)
#define CK_CTRL   (1u << 3)
#define CK_ALL    (CK_SENSE | CK_EST | CK_FDIR | CK_CTRL)

typedef enum { LOGM_OFF = 0, LOGM_ARMED, LOGM_REC } LogMode;
typedef char logq_fits_stage[((LOG_PRETRIG_RECS * LOGREC_SIZE) <= FW_STAGE_SIZE) ? 1 : -1];
typedef char log_rates_divide[(((FRAME_HZ % LOG_HZ_ASCENT) == 0u) && ((FRAME_HZ % LOG_HZ_DESCENT) == 0u)) ? 1 : -1];

static struct {
    I2C_HandleTypeDef *hi2c;
    Flight     F;                /* the portable flight pipeline (flight.c)    */
    GyroCal    gcal;
    ImuSample  imu;
    bool       overran, skip_overrun;
    uint32_t   frame, deadline, prev_t, t0, loop_us;
    float      dt;
    uint32_t   ckpt;
    uint32_t   imu_fails, overruns;
    bool       stream;           /* periodic status / telemetry on USB */
    bool       erase_req, reboot_req;
    bool       inject_imu;       /* fault injection: force IMU read failures */
    bool       clear_req;        /* console 'faults clear', served in Flight_Step */
    const char *reset_cause;
    uint32_t   reboot_at_ms;
    uint32_t   gps_gga_seen;     /* GGA count last fed to nav               */
    /* flight log (ADR-004 §4) */
    LogQ       lq;
    LogMode    logm;
    bool       log_space_ok;
    uint32_t   log_landed_ms;
    bool       log_landed;
#if CFG_HITL
    uint32_t   hitl_idx;         /* last host sample index                  */
    bool       hitl_missing;     /* no host sample this frame               */
    bool       hitl_seeded;      /* estimator re-seeded from host data      */
#endif
} A;

static const NavCfg k_nav_cfg = {
    .h_site_m = NAV_SITE_ELEV_M, .sat_mps2 = NAV_SAT_MPS2, .sat_budget_n = NAV_SAT_BUDGET_N, .still_acc_mps2 = NAV_STILL_ACC_MPS2,
    .still_gyro_radps = NAV_STILL_GYRO_RADPS, .acc_psd = NAV_ACC_PSD, .gps_var_m2 = NAV_GPS_VAR_M2,
    .gps_nis_max = NAV_GPS_NIS_MAX, .gps_rej_reset = NAV_GPS_REJ_RESET, .gps_v_var = NAV_GPS_V_VAR,
    .q_speed_min = NAV_Q_SPEED_MIN,
};
static const DetectCfg k_det_cfg = {
    .liftoff_acc = DET_LIFTOFF_ACC, .liftoff_n = DET_LIFTOFF_N,
    .liftoff_v = DET_LIFTOFF_V_MPS, .liftoff_n_nov = DET_LIFTOFF_N_NOV, .t_boost_min = DET_T_BOOST_MIN_S,
    .burnout_acc = DET_BURNOUT_ACC, .burnout_n = DET_BURNOUT_N, .apogee_n = DET_APOGEE_N,
    .t_apogee_max = DET_T_APOGEE_MAX_S, .t_land_min = DET_T_LAND_MIN_S, .t_land_max = DET_T_LAND_MAX_S,
    .land_acc_tol = DET_LAND_ACC_TOL, .land_gyro = DET_LAND_GYRO_RADPS, .land_v = DET_LAND_V_MPS,
    .land_n = DET_LAND_N, .land_tau = DET_LAND_TAU_S, .land_still_sd = DET_LAND_STILL_SD,
    .land_still_gyro = DET_LAND_STILL_GYRO, .land_shock_acc = DET_LAND_SHOCK_ACC,
    .land_n_shock = DET_LAND_N_SHOCK, .land_n_still = DET_LAND_N_STILL,
};

/* ---------------------------------------------------------------------------
 * Helpers
 * ------------------------------------------------------------------------- */
static Phase phase_now(void) { return Flight_Phase(&A.F); }
static const char *mode_name(CtrlMode m) { return Flight_ModeName(m); }
static uint16_t fault_bits(void) { return Flight_FaultBits(&A.F); }

/* Bounded copy into a fixed, NUL-padded field (no strncpy truncation traps). */
static void copy_text(char *dst, size_t n, const char *src)
{
    memset(dst, 0, n);
    memcpy(dst, src, strnlen(src, n));
}

/* ---------------------------------------------------------------------------
 * Flight log (ADR-004 §4): every record goes through the queue while the
 * log is armed or recording, so pre-trigger records, events and live
 * records stay in time order in flash.
 * ------------------------------------------------------------------------- */
static void log_emit(const uint8_t r[LOGREC_SIZE])
{
    if (A.logm != LOGM_OFF) { (void)LogQ_Push(&A.lq, r); }
}

static bool log_start_flash(void)
{
    LogBoot b; memset(&b, 0, sizeof b);
    b.t_us = Sched_MicrosNow();
    b.frame_hz = FRAME_HZ; b.log_hz = LOG_HZ_ASCENT;
    copy_text(b.build, sizeof b.build, g_build_id);
    return FlashLog_Start(&b);
}

static void log_drain(uint32_t max)
{
    if (A.logm != LOGM_REC) { return; }
    for (uint32_t k = 0u; k < max; k++) {
        const uint8_t *r = LogQ_Peek(&A.lq);
        if (r == NULL) { break; }
        (void)FlashLog_Write(r);        /* a write error is counted in flashlog, never retried */
        LogQ_Pop(&A.lq);
    }
}

static void log_close(void)
{
    if (A.logm == LOGM_REC) { log_drain(0xFFFFFFFFu); FlashLog_Stop(); }
    A.logm = LOGM_OFF;
    LogQ_Reset(&A.lq);
}

/* Event: console line + flight-log record (if logging). */
static void event(EventCode code, uint32_t arg0, const char *text)
{
    const Phase ph = phase_now();
    Con_Printf("[EVT] t=%lu ms %s: %s\r\n", (unsigned long)HAL_GetTick(), Phase_Name(ph), text);
    if (A.logm != LOGM_OFF) {
        LogEvent e;
        memset(&e, 0, sizeof e);
        e.t_us = Sched_MicrosNow(); e.seq = FlashLog_NextSeq();
        e.code = (uint8_t)code; e.phase = Phase_Index(ph); e.arg0 = arg0;
        e.arg1 = A.lq.dropped;
        copy_text(e.text, sizeof e.text, text);
        uint8_t r[LOGREC_SIZE];
        LogRec_PackEvent(r, &e);
        log_emit(r);
    }
}

/* Logger reaction to a phase edge (called from the flight-core callback). */
static void log_on_phase(Phase to)
{
    if (to == PH_READY) {
        if ((LOG_AUTOSTART != 0) && (A.logm == LOGM_OFF) && !Fw_Busy() && A.log_space_ok) {
            LogQ_Reset(&A.lq);
            A.logm = LOGM_ARMED;
            event(EV_LOG, LOG_PRETRIG_RECS, "log armed (pre-trigger)");
        }
    } else if (to == PH_BOOST) {
        if (A.logm != LOGM_REC) {
            if (log_start_flash()) {
                if (A.logm == LOGM_OFF) { LogQ_Reset(&A.lq); }
                LogQ_Commit(&A.lq);
                A.logm = LOGM_REC;
                event(EV_LOG, LogQ_Count(&A.lq), "log committed at liftoff");
            }
        }
    } else if (to == PH_LANDED) {
        A.log_landed = true; A.log_landed_ms = HAL_GetTick();
    } else if ((A.logm == LOGM_ARMED) && ((to == PH_SETTLING) || (to == PH_LOCKOUT))) {
        A.logm = LOGM_OFF;                        /* pad demotion: the ring is discarded */
        LogQ_Reset(&A.lq);
    } else {
        /* no log action */
    }
}

static void on_flight_event(void *ctx, EventCode code, uint32_t arg, const char *text)
{
    (void)ctx;
    event(code, arg, text);
    if (code == EV_PHASE) { log_on_phase((Phase)arg); }
}

static void go_phase(Phase to) { Flight_GoPhase(&A.F, to); }

/* ---------------------------------------------------------------------------
 * Tasks
 * ------------------------------------------------------------------------- */
#if CFG_HITL
/* Host sample in place of the IMU read (lockstep). The first sample re-seeds
 * the attitude and nav, which were seeded from the real board at boot. */
static void hitl_sense(void)
{
    HitlSample s;
    A.hitl_missing = !Hitl_Take(&s);
    A.imu.ok = false;
    if (!A.hitl_missing) {
        A.hitl_idx = s.idx;
        bool fin = true;
        for (uint32_t k = 0u; k < 3u; k++) {
            A.imu.accel[k] = s.accel[k]; A.imu.gyro[k] = s.gyro[k];
            fin = fin && isfinite(s.accel[k]) && isfinite(s.gyro[k]);
        }
        A.imu.ok = fin && ((s.flags & HITL_SF_FAIL) == 0u);
        if (A.imu.ok && !A.hitl_seeded) {
            const float m0[3] = { 0.0f, 0.0f, 0.0f };
            IEKF_Seed(&A.F.iekf, A.imu.accel, m0);
            Nav_Init(&A.F.nav, &k_nav_cfg);
            A.hitl_seeded = true;
            event(EV_MAINT, s.idx, "HITL live: IMU+GPS from host");
        }
    }
}
#endif

static void task_sense(void)
{
#if CFG_HITL
    if (Hitl_Live()) { hitl_sense(); } else { IMU_ReadBody(&A.gcal, &A.imu); }
#else
    IMU_ReadBody(&A.gcal, &A.imu);
#endif
#if CFG_FAULT_INJECTION
    if (A.inject_imu) { A.imu.ok = false; }
#endif
    if (!A.imu.ok) { A.imu_fails++; }
#if CFG_ENABLE_GPS
    GPS_Poll(256u);                               /* 9600 bps = ~5 B per 5 ms frame */
#endif
    A.ckpt |= CK_SENSE;
}

/* Estimate, monitor, arbitrate and control in one call (flight.c), then
 * command the servos and start their pulses (PWM_Commit, ADR-004 §2). */
static void task_flight(void)
{
    FlightIn in;
    memset(&in, 0, sizeof in);
    in.imu_ok = A.imu.ok;
    for (uint32_t k = 0u; k < 3u; k++) { in.accel[k] = A.imu.accel[k]; in.gyro_dps[k] = A.imu.gyro[k]; }
    in.loop_us = A.loop_us;
    in.overran = A.overran;
    in.skip_overrun = A.skip_overrun;
    in.now_ms = HAL_GetTick();
    in.clear_req = A.clear_req;
    A.clear_req = false;
#if CFG_ENABLE_GPS
    const GpsData *g = GPS_Get();
    in.gps_enabled = true;
    in.gps_alive = GPS_Alive(GPS_TIMEOUT_MS);
    if (g->gga != A.gps_gga_seen) {
        A.gps_gga_seen = g->gga;
        in.gps_new = true;
        in.gps_good = (g->fix_quality > 0u) && (g->sats >= NAV_GPS_SATS_MIN) && (g->hdop <= NAV_GPS_HDOP_MAX);
        in.gps_alt_msl = g->alt_msl_m;
    }
#endif
    A.log_space_ok = (FlashLog_CapacityBytes() - FlashLog_UsedBytes()) >= LOG_MIN_FREE_BYTES;
#if defined(CFG_FLIGHT_BUILD) && (CFG_FLIGHT_BUILD != 0)
    in.ready_inhibit = (LOG_AUTOSTART != 0) && !A.log_space_ok;   /* no flight without a log */
#endif
    Flight_Step(&A.F, &in, A.dt);
    A.skip_overrun = false;
    for (uint8_t i = 0u; i < FIN_COUNT; i++) { PWM_SetFin(i, A.F.fin[i]); }
    PWM_Commit();
    switch (A.F.last_clear) {
    case FCLR_OK:              Con_Printf("faults clear: OK\r\n"); break;
    case FCLR_IN_FLIGHT:       Con_Printf("ERR not in flight\r\n"); break;
    case FCLR_STILL_ACTIVE:    Con_Printf("ERR faults still active (%02lX): fix the cause first\r\n",
                                          (unsigned long)(A.F.fdir.active & Fdir_HardMask(false))); break;
    case FCLR_RECOVER_REFUSED: Con_Printf("ERR phase recover refused\r\n"); break;
    default: break;
    }
    A.ckpt |= CK_EST | CK_FDIR | CK_CTRL;
}

/* Every frame: drain the backlog first (so this frame's record always fits),
 * then the phase-scheduled STATE record and a 1 Hz AUX record. */
static void task_log(void)
{
    log_drain(LOG_DRAIN_PER_FRAME);
    if (A.logm == LOGM_OFF) { return; }
    const Phase ph = phase_now();
    const uint32_t dec = ((ph == PH_DESCENT) || (ph == PH_LANDED)) ? LOG_DECIMATE_DESCENT : LOG_DECIMATE;
    if ((A.frame % dec) == 0u) {
        LogState s;
        memset(&s, 0, sizeof s);
        s.t_us = A.t0; s.seq = FlashLog_NextSeq();
        s.phase = Phase_Index(ph); s.mode = (uint8_t)A.F.ctrl.mode;
        s.flags = (uint8_t)((A.imu.ok ? (LOGF_GYRO_OK | LOGF_ACCEL_OK) : 0u)
                | (A.F.acc_applied ? LOGF_ACC_APPLIED : 0u) | (A.overran ? LOGF_OVERRUN : 0u)
                | (A.F.shadow ? LOGF_SHADOW : 0u) | ((A.logm == LOGM_ARMED) ? LOGF_PRETRIG : 0u)
#if CFG_ENABLE_GPS
                | (GPS_HasFix(GPS_TIMEOUT_MS) ? LOGF_GPS_FIX : 0u)
#endif
                );
        for (uint32_t k = 0u; k < 4u; k++) {
            s.q[k] = A.F.iekf.q[k];
            s.fin[k] = A.F.shadow ? A.F.fin_cmd[k] : A.F.fin[k];
        }
        for (uint32_t k = 0u; k < 3u; k++) { s.w_dps[k] = A.imu.gyro[k]; s.a_ms2[k] = A.imu.accel[k]; }
        s.h_m = Nav_Height(&A.F.nav); s.v_up = Nav_VUp(&A.F.nav); s.qbar_pa = A.F.nav.qbar;
        s.trim_rad = A.F.ctrl.trim;
        s.loop_us = (A.loop_us > 0xFFFFu) ? 0xFFFFu : (uint16_t)A.loop_us;
        s.faults = fault_bits();
        uint8_t r[LOGREC_SIZE];
        LogRec_PackState(r, &s);
        log_emit(r);
    }
    if ((A.frame % FRAME_HZ) == 1u) {
        LogAux x;
        memset(&x, 0, sizeof x);
        x.t_us = A.t0; x.seq = FlashLog_NextSeq(); x.phase = Phase_Index(ph);
        x.nav_flags = (uint8_t)(A.F.nav.flags & 0xFFu); x.mode = (uint8_t)A.F.ctrl.mode;
        for (uint32_t k = 0u; k < 3u; k++) { x.bias_dps[k] = A.F.iekf.bias[k] * R2D; }
#if CFG_ENABLE_GPS
        const GpsData *g = GPS_Get();
        x.sats = g->sats; x.gps_alt_m = g->alt_msl_m;
        x.hdop10 = (g->hdop >= 25.5f) ? 255u : (uint8_t)(g->hdop * 10.0f);
#endif
        x.dropped = A.lq.dropped; x.imu_fails = (uint16_t)((A.imu_fails > 0xFFFFu) ? 0xFFFFu : A.imu_fails);
        x.wcet_us = (uint16_t)((A.loop_us > 0xFFFFu) ? 0xFFFFu : A.loop_us);
        uint8_t r[LOGREC_SIZE];
        LogRec_PackAux(r, &x);
        log_emit(r);
    }
    if (A.log_landed && ((HAL_GetTick() - A.log_landed_ms) >= LOG_POST_LAND_MS) && (A.logm == LOGM_REC)) {
        event(EV_LOG, A.lq.dropped, "log closed after landing");
        log_close();
        A.log_landed = false;
    }
}

#if CFG_TELEM_BINARY
static void send_binary(void)
{
    TelemState st;
    st.t_us = A.t0; st.frame = A.frame;
    IEKF_GetEuler(&A.F.iekf, &st.euler[0], &st.euler[1], &st.euler[2]);
    for (uint32_t k = 0u; k < 3u; k++) {
        st.omega[k] = A.imu.gyro[k]; st.accel[k] = A.imu.accel[k];
        st.mag[k] = 0.0f; st.bias[k] = A.F.iekf.bias[k];
    }
    for (uint32_t k = 0u; k < 4u; k++) { st.q[k] = A.F.iekf.q[k]; st.fin[k] = A.F.fin[k]; }
    const Phase ph = phase_now();
    uint16_t h = (uint16_t)((uint32_t)A.F.ctrl.mode << TELEM_H_MODE_SHIFT);
    if (A.imu.ok)                      { h |= TELEM_H_ACCEL_OK | TELEM_H_GYRO_OK; }
    if (A.F.acc_applied)                 { h |= TELEM_H_ACCEL_APPLIED; }
    if (A.F.ctrl.mode != CTRL_MODE_OFF)  { h |= TELEM_H_CTRL_ACTIVE; }
    if (A.overran)                     { h |= TELEM_H_OVERRUN; }
    if (!Phase_ActuationAllowed(ph, CFG_BENCH_ACTUATE_READY != 0)) { h |= TELEM_H_SETTLING; }
    if (Fdir_Worst(&A.F.fdir, Phase_InFlight(ph)) >= SEV_SOFT)      { h |= TELEM_H_FAULT; }
    if ((ph == PH_LOCKOUT) || (ph == PH_CATO_SAFE))               { h |= TELEM_H_LOCKOUT; }
    st.health = h;
    st.loop_us = (A.loop_us > 0xFFFFu) ? 0xFFFFu : (uint16_t)A.loop_us;
    (void)Telem_SendState(&st);
}
#else
static void send_text(void)
{
    float r, p, y;
    IEKF_GetEuler(&A.F.iekf, &r, &p, &y);
    const float an = sqrtf((A.imu.accel[0] * A.imu.accel[0]) + (A.imu.accel[1] * A.imu.accel[1])
                           + (A.imu.accel[2] * A.imu.accel[2])) / BOARD_G_MPS2;
    const GpsData *g = GPS_Get();
#if CFG_ENABLE_GPS
    const char *gst = GPS_HasFix(GPS_TIMEOUT_MS) ? "FIX" : (GPS_Alive(GPS_TIMEOUT_MS) ? "nofix" : "none");
#else
    const char *gst = "off";
#endif
    uint32_t l = 0xFFFFFFFFu;
    (void)Fdir_LatchRead(&A.F.fdir, &l);
    char b[15][CON_FX_LEN];
    Con_Printf("t=%lu.%02lu %s %s f=%02lX/%02lX RPY %s %s %s w %s %s %s |a|=%s fin %s %s %s %s "
               "imu=%s(%lu) loop=%lu ovr=%lu gps=%s s%u alt=%s rx=%lu nmea=%lu log=%lu%% h=%s vz=%s q=%s\r\n",
               (unsigned long)(A.t0 / 1000000u), (unsigned long)((A.t0 / 10000u) % 100u),
               Phase_Name(phase_now()), mode_name(A.F.ctrl.mode),
               (unsigned long)A.F.fdir.active, (unsigned long)l,
               Con_Fx(b[0], r, 1u), Con_Fx(b[1], p, 1u), Con_Fx(b[2], y, 1u),
               Con_Fx(b[3], A.F.iekf.omega[0] * R2D, 1u), Con_Fx(b[4], A.F.iekf.omega[1] * R2D, 1u),
               Con_Fx(b[5], A.F.iekf.omega[2] * R2D, 1u), Con_Fx(b[6], an, 2u),
               Con_Fx(b[7], A.F.fin[0], 2u), Con_Fx(b[8], A.F.fin[1], 2u),
               Con_Fx(b[9], A.F.fin[2], 2u), Con_Fx(b[10], A.F.fin[3], 2u),
               A.imu.ok ? "OK" : "FAIL", (unsigned long)A.imu_fails,
               (unsigned long)A.loop_us, (unsigned long)A.overruns,
               gst, (unsigned)g->sats, Con_Fx(b[11], g->alt_msl_m, 1u),
               (unsigned long)g->bytes, (unsigned long)g->sentences,
               (unsigned long)((FlashLog_UsedBytes() * 100u) / FlashLog_CapacityBytes()),
               Con_Fx(b[12], Nav_Height(&A.F.nav), 1u), Con_Fx(b[13], Nav_VUp(&A.F.nav), 1u),
               Con_Fx(b[14], A.F.nav.qbar, 0u));
}
#endif

static void task_telem(void)
{
    /* Quiet while a host protocol (fw update, log pull) owns the link. */
    if (!A.stream || Fw_Busy() || FlashLog_Pulling() || !UsbIo_Connected()) { return; }
#if CFG_TELEM_BINARY
    send_binary();
#else
    send_text();
#endif
}

static void task_comms(void)
{
#if CFG_HITL
    Hitl_Poll();                                  /* frames to the seam, text to the console */
#else
    Con_Poll();
#endif
    Fw_Task();
    FlashLog_PullTask();
    UsbIo_Task();
    if (A.reboot_req && ((int32_t)(HAL_GetTick() - A.reboot_at_ms) >= 0)) { NVIC_SystemReset(); }
}

static void task_leds(void)
{
    GpsLed g = GPS_LED_NONE;
#if CFG_ENABLE_GPS
    g = GPS_HasFix(GPS_TIMEOUT_MS) ? GPS_LED_FIX : (GPS_Alive(GPS_TIMEOUT_MS) ? GPS_LED_NOFIX : GPS_LED_NONE);
#endif
    const uint32_t now = HAL_GetTick();
    Leds_Update(phase_now(), (int32_t)(A.F.degraded_until_ms - now) > 0, g, now);
}

/* ---------------------------------------------------------------------------
 * Task table (rate groups as divisors of the 100 Hz frame; offsets stagger
 * the slow tasks). WCET is measured per task at the build's optimisation.
 * ------------------------------------------------------------------------- */
typedef struct {
    const char *name;
    void      (*run)(void);
    uint16_t    period, offset;          /* in frames */
    uint32_t    wcet_us, last_us;
} Task;

static Task s_tasks[] = {
    { "sense",    task_sense,    1u,                 0u, 0u, 0u },
    { "flight",   task_flight,   1u,                 0u, 0u, 0u },
    { "log",      task_log,      1u,                 0u, 0u, 0u },
#if CFG_TELEM_BINARY
    { "telem",    task_telem,    TELEM_DECIMATE,     0u, 0u, 0u },
#else
    { "telem",    task_telem,    TEXT_STATUS_DECIMATE, 3u, 0u, 0u },
#endif
    { "comms",    task_comms,    1u,                 0u, 0u, 0u },
    { "leds",     task_leds,     1u,                 0u, 0u, 0u },
};
#define N_TASKS (sizeof s_tasks / sizeof s_tasks[0])

/* Scheduler maintenance between frames (log erase): fins centred, then the
 * frame reference is re-based and the one late frame is not counted as an
 * overrun. The only place the "never re-sync" rule is relaxed, by design. */
static void maintenance(void)
{
    if (!A.erase_req) { return; }
    A.erase_req = false;
    PWM_CentreFins();
    Con_Printf("log erase: %s\r\n", FlashLog_Erase() ? "OK" : "FAILED");
    event(EV_MAINT, 0u, "log erased");
    A.deadline = Sched_MicrosNow() + FRAME_PERIOD_US;
    A.prev_t = Sched_MicrosNow();
    A.skip_overrun = true;
}

/* ---------------------------------------------------------------------------
 * Console commands
 * ------------------------------------------------------------------------- */
static void cmd_help(uint32_t argc, char *argv[]) { (void)argc; (void)argv; Con_Help(); }

static void cmd_ver(uint32_t argc, char *argv[])
{
    (void)argc; (void)argv;
    Con_Printf("Hyades FC-V4 (STM32F411, QMI8658A) build %s %s, last reset: %s\r\n",
               g_build_id, __TIME__, A.reset_cause);
}

static void cmd_stream(uint32_t argc, char *argv[])
{
    if (argc >= 2u) { A.stream = (strcmp(argv[1], "off") != 0); }
    Con_Printf("stream %s\r\n", A.stream ? "on" : "off");
}

/* Operator reset of latched faults (pad only). LOCKOUT is otherwise terminal
 * until reboot; this is the console equivalent of that reboot, without losing
 * the calibration. Refused in flight/CATO, and while any HARD monitor is still
 * failing (the cause must be gone first). Re-entry is via SETTLE, so READY
 * again needs the full fault-free hold. Bench fault injection is cancelled. */
static void faults_clear_request(void)
{
    const Phase ph = phase_now();
    if (Phase_InFlight(ph) || (ph == PH_CATO_SAFE)) { Con_Printf("ERR not in flight\r\n"); return; }
#if CFG_FAULT_INJECTION
    A.inject_imu = false;                 /* bench injection ends; its monitor recovers next frame */
#endif
    A.clear_req = true;
}

static void cmd_faults(uint32_t argc, char *argv[])
{
    if ((argc >= 2u) && (strcmp(argv[1], "clear") == 0)) { faults_clear_request(); return; }
    uint32_t l = 0u;
    const bool ok = Fdir_LatchRead(&A.F.fdir, &l);
    Con_Printf("phase %s  ctrl %s  latch %s%08lX\r\n", Phase_Name(phase_now()), mode_name(A.F.ctrl.mode),
               ok ? "" : "CORRUPT ", (unsigned long)l);
    Con_Printf("  monitor    act lat  trips  count  last_r\r\n");
    for (uint32_t i = 0u; i < (uint32_t)MON_COUNT; i++) {
        char b[CON_FX_LEN];
        Con_Printf("  %-10s %u   %u   %5u  %5u  %s\r\n", Fdir_Config((MonId)i)->name,
                   (unsigned)((A.F.fdir.active >> i) & 1u), (unsigned)((l >> i) & 1u),
                   (unsigned)A.F.fdir.trips[i], (unsigned)A.F.fdir.count[i], Con_Fx(b, A.F.fdir.last_r[i], 3u));
    }
}

static void cmd_tasks(uint32_t argc, char *argv[])
{
    (void)argc; (void)argv;
    Con_Printf("  task      period  last_us  wcet_us   (frame %lu us, budget %lu us)\r\n",
               (unsigned long)FRAME_PERIOD_US, (unsigned long)FDIR_LOOP_BUDGET_US);
    for (uint32_t i = 0u; i < N_TASKS; i++) {
        Con_Printf("  %-9s %5u  %7lu  %7lu\r\n", s_tasks[i].name, (unsigned)s_tasks[i].period,
                   (unsigned long)s_tasks[i].last_us, (unsigned long)s_tasks[i].wcet_us);
    }
    Con_Printf("  overruns %lu, usb tx dropped %lu B, rx dropped %lu B\r\n",
               (unsigned long)A.overruns, (unsigned long)UsbIo_TxDropped(), (unsigned long)UsbIo_RxDropped());
}

#if CFG_ENABLE_GPS
/* Wiring/traffic diagnosis from the boot probe, plus what has arrived since. */
static void gps_report(const char *pfx)
{
    const GpsProbe *p = GPS_ProbeResult();
    Con_Printf("%sGPS probe: PA3(rx) %s %lue ~%lu Bd | PA2(tx) %s %lue -> %s\r\n", pfx,
               GPS_LevelName(p->rx_level), (unsigned long)p->rx_edges, (unsigned long)p->rx_baud,
               GPS_LevelName(p->tx_level), (unsigned long)p->tx_edges, GPS_Advice());
}
#endif

static void cmd_gps(uint32_t argc, char *argv[])
{
#if CFG_ENABLE_GPS
    if ((argc >= 2u) && (strcmp(argv[1], "raw") == 0)) {
        const char *ln[GPS_RAW_LINES];
        const uint32_t n = GPS_RawLines(ln);
        if (n == 0u) { Con_Printf("gps raw: no NMEA lines received\r\n"); }
        for (uint32_t k = 0u; k < n; k++) { Con_Printf("  %s\r\n", ln[k]); }
        return;
    }
    if ((argc >= 2u) && (strcmp(argv[1], "probe") == 0)) { gps_report(""); return; }
    const GpsData *g = GPS_Get();
    char a[CON_FX_LEN], b[CON_FX_LEN], c[CON_FX_LEN], d[CON_FX_LEN];
    Con_Printf("gps fix=%u sats=%u hdop=%s alt=%s m utc=%06lu  lat/lon(x1e4)=%s,%s\r\n",
               (unsigned)g->fix_quality, (unsigned)g->sats, Con_Fx(a, g->hdop, 1u), Con_Fx(b, g->alt_msl_m, 1u),
               (unsigned long)g->utc_hhmmss, Con_Fx(c, (float)(g->lat_deg * 1e4), 0u), Con_Fx(d, (float)(g->lon_deg * 1e4), 0u));
    Con_Printf("    bytes=%lu nmea=%lu gga=%lu rmc=%lu cksum_err=%lu overrun=%lu (USART2 %lu Bd)\r\n",
               (unsigned long)g->bytes, (unsigned long)g->sentences, (unsigned long)g->gga,
               (unsigned long)g->rmc, (unsigned long)g->cksum_err, (unsigned long)GPS_Overruns(),
               (unsigned long)GPS_BAUD);
#else
    (void)argc; (void)argv;
    Con_Printf("gps disabled (CFG_ENABLE_GPS 0)\r\n");
#endif
}

/* Bench noise capture (Allan/GMWM): every ODR sample, raw counts, as binary
 * IMU frames (telemetry.h). Leaves the flight loop for good — control and
 * FDIR stop, fins centred, LEDs show LOCKOUT — and ends only with 'reboot'
 * or a power cycle, so it can never be half-active in a flight state. Polls
 * the sensor every ~1 ms (ODR 224 Hz); gaps show as ts jumps on the host. */
static void imu_capture(void) __attribute__((noreturn));
static void imu_capture(void)
{
    const Qmi8658 *d = IMU_Driver();
    log_close();
    PWM_CentreFins();
    A.stream = false;
    Con_Printf("IMUCAP v1 odr_mHz=%lu a_lsb_per_g=%lu g_lsb_per_dps_x1000=%lu ctrl=%02X %02X %02X %02X %02X %02X %02X "
               "build=%s (binary IMU frames follow; 'reboot' to end)\r\n",
               (unsigned long)(d->odr_hz * 1000.0f + 0.5f), (unsigned long)(d->a_lsb_per_g + 0.5f),
               (unsigned long)(d->g_lsb_per_dps * 1000.0f + 0.5f), d->ctrl_rb[0], d->ctrl_rb[1], d->ctrl_rb[2],
               d->ctrl_rb[3], d->ctrl_rb[4], d->ctrl_rb[5], d->ctrl_rb[6], g_build_id);
    uint32_t next = Sched_MicrosNow();
    for (;;) {
        Wdg_Kick();
        Con_Poll();                                   /* 'reboot' still works */
        UsbIo_Task();
        Leds_Update(PH_LOCKOUT, false, GPS_LED_NONE, HAL_GetTick());
        if (A.reboot_req && ((int32_t)(HAL_GetTick() - A.reboot_at_ms) >= 0)) { NVIC_SystemReset(); }
        if ((int32_t)(Sched_MicrosNow() - next) < 0) { continue; }
        next += 1000u;
        Qmi8658Raw r; uint32_t dts = 0u;
        if (IMU_ReadRaw(&r, &dts) && (dts != 0u) && UsbIo_Connected()) {
            (void)Telem_SendImu(r.ts, r.temp, r.a, r.g);
        }
    }
}

static void cmd_imu(uint32_t argc, char *argv[])
{
    if ((argc >= 2u) && (strcmp(argv[1], "capture") == 0)) {
        const Phase ph = phase_now();
        static bool s_capturing;                       /* 'imu capture' typed again from inside */
        if (s_capturing) { Con_Printf("ERR capture running ('reboot' to end)\r\n"); return; }
        if (Phase_InFlight(ph) || (ph == PH_CATO_SAFE)) { Con_Printf("ERR not in flight\r\n"); return; }
        s_capturing = true;
        imu_capture();
    }
    const Qmi8658 *d = IMU_Driver();
    char a[CON_FX_LEN], b[CON_FX_LEN], c[CON_FX_LEN];
    Con_Printf("imu QMI8658A whoami=0x%02X rev=0x%02X reads=%lu i2c_err=%lu torn=%lu/%lu stale=%lu\r\n",
               d->whoami, d->revision, (unsigned long)d->reads, (unsigned long)d->i2c_errors,
               (unsigned long)d->torn_retries, (unsigned long)d->torn_giveups, (unsigned long)d->stale);
    Con_Printf("    gyro boot bias dps %s %s %s\r\n", Con_Fx(a, A.gcal.bias[0], 3u),
               Con_Fx(b, A.gcal.bias[1], 3u), Con_Fx(c, A.gcal.bias[2], 3u));
}

static void cmd_log(uint32_t argc, char *argv[])
{
    const bool flying = Phase_InFlight(phase_now());
    const char *sub = (argc >= 2u) ? argv[1] : "info";
    if (strcmp(sub, "start") == 0) {
        if (A.logm == LOGM_REC) { Con_Printf("log start: already recording\r\n"); return; }
        const bool ok = log_start_flash();          /* bench session: straight to recording */
        if (ok) { if (A.logm == LOGM_OFF) { LogQ_Reset(&A.lq); } LogQ_Commit(&A.lq); A.logm = LOGM_REC; }
        Con_Printf("log start: %s\r\n", ok ? "OK" : "FAILED (full? 'log erase')");
        if (ok) { event(EV_LOG, 0u, "log start"); }
    } else if (strcmp(sub, "stop") == 0) {
        if (flying) { Con_Printf("ERR not in flight\r\n"); return; }
        event(EV_LOG, 0u, "log stop");
        log_close();
        Con_Printf("log stop: OK\r\n");
    } else if (strcmp(sub, "erase") == 0) {
        if (flying) { Con_Printf("ERR not in flight\r\n"); return; }
        Con_Printf("log erase: erasing 384 KB (~3-6 s, fins centred)...\r\n");
        A.erase_req = true;
    } else if (strcmp(sub, "pull") == 0) {
        if (!FlashLog_PullStart()) { Con_Printf("ERR pull busy\r\n"); }
    } else {
        Con_Printf("log %s, %lu/%lu B used (%lu records), %lu write errors\r\n",
                   (A.logm == LOGM_REC) ? "RECORDING" : ((A.logm == LOGM_ARMED) ? "ARMED (pre-trigger)" : "idle"),
                   (unsigned long)FlashLog_UsedBytes(),
                   (unsigned long)FlashLog_CapacityBytes(), (unsigned long)(FlashLog_UsedBytes() / LOGREC_SIZE),
                   (unsigned long)FlashLog_WriteErrors());
    }
}

static void cmd_fw(uint32_t argc, char *argv[])
{
    if (Phase_InFlight(phase_now())) { Con_Printf("FWABORT in-flight\r\n"); return; }
    if (A.logm != LOGM_OFF) { event(EV_LOG, 0u, "log stop (fw update)"); log_close(); }  /* frees the stage RAM */
    Fw_Command(argc, argv);
}

static void cmd_reboot(uint32_t argc, char *argv[])
{
    (void)argc; (void)argv;
    bool sim = false;                             /* HITL: the "flight" is simulated */
#if CFG_HITL
    sim = Hitl_Live();
#endif
    if (Phase_InFlight(phase_now()) && !sim) { Con_Printf("ERR not in flight\r\n"); return; }
    log_close();
    PWM_CentreFins();
    Con_Printf("rebooting\r\n");
    A.reboot_req = true;
    A.reboot_at_ms = HAL_GetTick() + 100u;
}

#if CFG_FAULT_INJECTION
/* Ground-test fault injection (FDS-01 §9.2). Each must land in the predicted
 * safe state: wdg -> watchdog reset -> boot into LOCKOUT; phase -> corrupt
 * protected word -> LOCKOUT; imu -> HARD imu_read trip -> LOCKOUT, fins OFF. */
static void cmd_inject(uint32_t argc, char *argv[])
{
    const char *what = (argc >= 2u) ? argv[1] : "";
    if (Phase_InFlight(phase_now())) { Con_Printf("ERR not in flight\r\n"); return; }
    if (strcmp(what, "wdg") == 0) {
        Con_Printf("inject wdg: stalling the frame (expect watchdog reset)\r\n");
        for (uint32_t i = 0u; i < 50u; i++) { UsbIo_Task(); HAL_Delay(2); }
        PWM_CentreFins();
        for (;;) { }                                   /* interrupts still run; no kick */
    } else if (strcmp(what, "phase") == 0) {
        A.F.ph.v ^= 0x10u;                               /* single-bit upset */
        Con_Printf("inject phase: flipped one bit of the phase word\r\n");
    } else if (strcmp(what, "imu") == 0) {
        A.inject_imu = true;
        Con_Printf("inject imu: forcing IMU read failures\r\n");
    } else {
        Con_Printf("usage: inject wdg|phase|imu\r\n");
    }
}
#endif

static const ConCmd k_cmds[] = {
    { "help",   "                         this list",                          cmd_help   },
    { "ver",    "                         build id",                           cmd_ver    },
    { "stream", "[on|off]                 periodic status/telemetry",          cmd_stream },
    { "faults", "[clear]                  FDIR monitors, latch; clear on pad",  cmd_faults },
    { "tasks",  "                         per-task timing (WCET)",             cmd_tasks  },
    { "gps",    "[raw|probe]              GNSS detail, last NMEA, wiring probe", cmd_gps    },
    { "imu",    "[capture]                IMU diagnostics; raw noise capture (ends by reboot)", cmd_imu },
    { "log",    "[info|start|stop|erase|pull]  flight log (internal flash)",   cmd_log    },
    { "fw",     "<size> <crc32hex>        USB firmware update (fc_flash.py)",  cmd_fw     },
    { "reboot", "                         reset (not in flight)",              cmd_reboot },
#if CFG_FAULT_INJECTION
    { "inject", "wdg|phase|imu            bench fault injection",              cmd_inject },
#endif
};

/* ---------------------------------------------------------------------------
 * Boot
 * ------------------------------------------------------------------------- */
static const char *reset_cause(uint32_t csr)
{
    if ((csr & RCC_CSR_IWDGRSTF) != 0u) { return "WATCHDOG"; }
    if ((csr & RCC_CSR_SFTRSTF)  != 0u) { return "software"; }
    if ((csr & RCC_CSR_PORRSTF)  != 0u) { return "power-on"; }
    if ((csr & RCC_CSR_BORRSTF)  != 0u) { return "brown-out"; }
    if ((csr & RCC_CSR_PINRSTF)  != 0u) { return "reset pin"; }
    return "other";
}

#if CFG_ENABLE_BOOTVERIFY
/* Run the FULL control path on synthetic inputs (scratch controller, no servo
 * motion) and log the fins, to check signs/order. Attitude cases respond only
 * through CTRL_KR_* (zero = rate-only tuning, rows read zero); the rate case
 * exercises CTRL_KW_ROLL. Expected for a + input: +pitch(X) top -, bottom +;
 * +yaw(Y) right -, left +; +roll(Z) all -; +roll rate all -. With
 * CTRL_ENABLE_PITCHYAW = 0 the pitch/yaw rows must read zero. */
static void boot_verify(void)
{
    Con_Printf("[BOOT] control-path check (KR roll %s, KW roll %s), fins 0=top 1=right 2=bottom 3=left\r\n",
               (CTRL_KR_ROLL != 0.0f) ? "on" : "0", (CTRL_KW_ROLL != 0.0f) ? "on" : "0");
    const float d = 0.20f, c = cosf(0.5f * d), sn = sinf(0.5f * d);
    const struct { const char *name; float q[4]; float w[3]; } cases[4] = {
        { "+pitch(X) ", { c, sn, 0.0f, 0.0f },       { 0.0f, 0.0f, 0.0f } },
        { "+yaw(Y)   ", { c, 0.0f, sn, 0.0f },       { 0.0f, 0.0f, 0.0f } },
        { "+roll(Z)  ", { c, 0.0f, 0.0f, sn },       { 0.0f, 0.0f, 0.0f } },
        { "+roll rate", { 1.0f, 0.0f, 0.0f, 0.0f }, { 0.0f, 0.0f, 1.0f } },
    };
    for (uint32_t k = 0u; k < 4u; k++) {
        Controller s;
        Ctrl_Init(&s);
        float fin[4];
        /* One OFF step sets the rate reference (as in flight), so the FULL step
         * sees a steady rate, not a spurious angular-acceleration spike. */
        Ctrl_Update(&s, cases[k].q, cases[k].w, cases[k].w, FRAME_DT_S, fin);
        Ctrl_SetMode(&s, CTRL_MODE_FULL);
        Ctrl_Update(&s, cases[k].q, cases[k].w, cases[k].w, FRAME_DT_S, fin);
        char b[4][CON_FX_LEN];
        Con_Printf("[BOOT]   %s fins %s %s %s %s\r\n", cases[k].name, Con_Fx(b[0], fin[0], 3u),
                   Con_Fx(b[1], fin[1], 3u), Con_Fx(b[2], fin[2], 3u), Con_Fx(b[3], fin[3], 3u));
    }
}
#endif

#if CFG_ENABLE_SERVO_SWEEP
/* Each axis to +/- full deflection, then each fin alone. Airframe RESTRAINED,
 * fin arc CLEAR. Boot only (before the watchdog starts). */
static void servo_sweep(void)
{
    static const float pat[3][4] = {
        { +1.0f,  0.0f, -1.0f,  0.0f }, {  0.0f, +1.0f,  0.0f, -1.0f }, { +1.0f, +1.0f, +1.0f, +1.0f },
    };
    Con_Printf("[SWEEP] restrain the airframe, keep the fin arc clear\r\n");
    for (uint32_t a = 0u; a < 3u; a++) {
        for (int32_t sgn = 1; sgn >= -1; sgn -= 2) {
            for (uint8_t i = 0u; i < FIN_COUNT; i++) { PWM_SetFin(i, (float)sgn * pat[a][i]); }
            HAL_Delay(SWEEP_HOLD_MS);
            PWM_CentreFins();
            HAL_Delay(SWEEP_STEP_MS);
        }
    }
    for (uint8_t k = 0u; k < FIN_COUNT; k++) {
        PWM_SetFin(k, 1.0f); HAL_Delay(SWEEP_HOLD_MS); PWM_CentreFins(); HAL_Delay(SWEEP_STEP_MS);
    }
}
#endif

static void boot(UART_HandleTypeDef *huart)
{
    const uint32_t csr = RCC->CSR;
    RCC->CSR |= RCC_CSR_RMVF;                         /* clear the reset flags */
    A.reset_cause = reset_cause(csr);

    UsbIo_Init();
    Con_Init(k_cmds, (uint32_t)(sizeof k_cmds / sizeof k_cmds[0]));
    Sched_Init();
    PWM_Init();                                       /* all fins centred */
    Flight_Init(&A.F, &k_nav_cfg, &k_det_cfg, MS_TO_FRAMES(READY_HOLD_MS), NAV_BRIDGE_N,
                CFG_BENCH_ACTUATE_READY != 0, on_flight_event, NULL);
    LogQ_Init(&A.lq, (uint8_t (*)[LOGREC_SIZE])(void *)Fw_StageBuffer(), LOG_PRETRIG_RECS);
    A.logm = LOGM_OFF;
    FlashLog_Init();
    A.stream = true;
    Leds_Update(PH_BOOT, false, GPS_LED_NONE, 0u);

    Con_Printf("\r\n=== Hyades FC-V4 (F411 %lu MHz) build %s, reset: %s ===\r\n",
               (unsigned long)(HAL_RCC_GetSysClockFreq() / 1000000u), g_build_id, A.reset_cause);
    Con_Printf("[BOOT] log %lu/%lu B used. Type 'help' for commands.\r\n",
               (unsigned long)FlashLog_UsedBytes(), (unsigned long)FlashLog_CapacityBytes());

    (void)huart;                                      /* GPS ports are set up by gps.c */
#if CFG_ENABLE_GPS
    GPS_Init(1100u);                                  /* blocking probe: before the IWDG */
    GPS_Poll(4096u);
    gps_report("[BOOT] ");
#endif

    if (!IMU_Init(A.hi2c)) {
        event(EV_BOOT, 0u, "IMU init/self-test FAILED");
        go_phase(PH_LOCKOUT);
        return;
    }
    go_phase(PH_CALIBRATE);
    Leds_Update(PH_CALIBRATE, false, GPS_LED_NONE, 0u);
    Con_Printf("[BOOT] calibrating gyro - keep still\r\n");
    IMU_CalibrateGyro(&A.gcal);
    {
        float a0[3] = { 0.0f, 0.0f, 0.0f };
        const float m0[3] = { 0.0f, 0.0f, 0.0f };      /* no magnetometer */
        uint32_t n = 0u;
        for (uint32_t i = 0u; i < 32u; i++) {
            ImuSample s;
            IMU_ReadBody(&A.gcal, &s);
            if (s.ok) { for (uint32_t k = 0u; k < 3u; k++) { a0[k] += s.accel[k]; } n++; }
            HAL_Delay(5);
        }
        if (n > 0u) { for (uint32_t k = 0u; k < 3u; k++) { a0[k] /= (float)n; } }
        IEKF_Seed(&A.F.iekf, a0, m0);
        float r, p, y;
        IEKF_GetEuler(&A.F.iekf, &r, &p, &y);
        char b[6][CON_FX_LEN];
        Con_Printf("[BOOT] gyro bias dps %s %s %s | seed RPY deg %s %s %s\r\n",
                   Con_Fx(b[0], A.gcal.bias[0], 3u), Con_Fx(b[1], A.gcal.bias[1], 3u),
                   Con_Fx(b[2], A.gcal.bias[2], 3u), Con_Fx(b[3], r, 1u), Con_Fx(b[4], p, 1u),
                   Con_Fx(b[5], y, 1u));
    }
    /* After the seed, so the estimator is still meaningful for diagnostics. */
    if ((csr & RCC_CSR_IWDGRSTF) != 0u) {             /* FDS-01 §5.2 */
        event(EV_BOOT, csr, "watchdog reset -> LOCKOUT");
        go_phase(PH_LOCKOUT);
        return;
    }
#if CFG_ENABLE_BOOTVERIFY
    boot_verify();
#endif
#if CFG_ENABLE_SERVO_SWEEP
    servo_sweep();
#endif
    go_phase(PH_SETTLING);
}

#if CFG_HITL
/* Wait for the host's next sample, servicing USB meanwhile. Bounded by
 * HITL_WAIT_US (and an iteration cap): a missing sample becomes a failed IMU
 * read in task_sense, never a hang or a starved watchdog. */
static void hitl_wait(void)
{
    const uint32_t t0 = Sched_MicrosNow();
    for (uint32_t i = 0u; (i < 1000000u) && !Hitl_Pending(); i++) {
        UsbIo_Task();
        Hitl_Poll();
        if ((Sched_MicrosNow() - t0) >= HITL_WAIT_US) { break; }
    }
}

static void hitl_reply(void)
{
    HitlReply r;
    memset(&r, 0, sizeof r);
    r.idx = A.hitl_idx;
    r.phase = Phase_Index(phase_now());
    r.mode = (uint8_t)A.F.ctrl.mode;
    r.faults = fault_bits();
    r.loop_us = (A.loop_us > 0xFFFFu) ? 0xFFFFu : (uint16_t)A.loop_us;
    r.nav_flags = (uint8_t)(A.F.nav.flags & 0xFFu);
    r.hitl_flags = A.hitl_missing ? HITL_RF_MISSING : 0u;
    for (uint32_t k = 0u; k < 4u; k++) { r.fin[k] = A.F.fin[k]; r.q[k] = A.F.iekf.q[k]; }
    r.h = Nav_Height(&A.F.nav); r.v_up = Nav_VUp(&A.F.nav); r.speed = A.F.nav.speed; r.qbar = A.F.nav.qbar;
    (void)Hitl_Reply(&r);
}
#endif

void App_Run(I2C_HandleTypeDef *hi2c, UART_HandleTypeDef *huart)
{
    memset(&A, 0, sizeof A);
    A.hi2c = hi2c;
    boot(huart);
#if CFG_ENABLE_IWDG
    Wdg_Start();
#endif
#if CFG_TELEM_BINARY
    Con_Printf("[BOOT] binary STATE telemetry at %lu Hz (0xAA55 frames)\r\n",
               (unsigned long)(FRAME_HZ / TELEM_DECIMATE));
#else
    Con_Printf("[BOOT] status %lu Hz: t phase ctrl f=active/latch RPY(deg) w(dps) |a|(g) fins "
               "imu(fails) loop(us) ovr gps sats alt rxB nmea log%%  ('stream off' to pause)\r\n",
               (unsigned long)(FRAME_HZ / TEXT_STATUS_DECIMATE));
#endif

    A.deadline = Sched_MicrosNow() + FRAME_PERIOD_US;
    A.prev_t   = Sched_MicrosNow();
    for (;;) {
#if CFG_HITL
        const bool lockstep = Hitl_Live();
#else
        const bool lockstep = false;
#endif
        if (lockstep) {
#if CFG_HITL
            hitl_wait();                          /* host-paced, bounded */
#endif
            A.overran = false;                    /* timing is H5 (real-time mode) */
            A.deadline = Sched_MicrosNow() + FRAME_PERIOD_US;
        } else {
            /* Late at the top of the frame = the previous frame overran (detect,
             * never mask: the deadline advances by exactly one period). */
            A.overran = ((int32_t)(Sched_MicrosNow() - A.deadline) > 0);
            if (A.overran && !A.skip_overrun) { A.overruns++; }
            Sched_WaitUntil(A.deadline);
            A.deadline += FRAME_PERIOD_US;
        }

        A.t0 = Sched_MicrosNow();
        A.dt = (float)(A.t0 - A.prev_t) * 1e-6f;
        A.prev_t = A.t0;
        if (lockstep || (A.dt <= 0.0f) || (A.dt > 0.1f)) { A.dt = FRAME_DT_S; }   /* sim time */

        A.ckpt = 0u;
        for (uint32_t i = 0u; i < N_TASKS; i++) {
            Task *t = &s_tasks[i];
            if ((A.frame % t->period) != t->offset) { continue; }
            const uint32_t ts = Sched_MicrosNow();
            t->run();
            t->last_us = Sched_MicrosNow() - ts;
            if (t->last_us > t->wcet_us) { t->wcet_us = t->last_us; }
        }
        A.loop_us = Sched_MicrosNow() - A.t0;
#if CFG_HITL
        if (lockstep) { hitl_reply(); }
#endif

        if (A.ckpt == CK_ALL) { Wdg_Kick(); }        /* std D3: completed frame only */
        maintenance();
        A.frame++;
    }
}
